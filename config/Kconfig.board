## config/Kconfig.board
```kconfig
# Technikable board configuration

# Copyright (c) 2021 Pete Johanson
# SPDX-License-Identifier: MIT

config BOARD_TECHNIKABLE
	bool "Technik-a-ble"
	depends on SOC_NRF52840_QIAA
```
